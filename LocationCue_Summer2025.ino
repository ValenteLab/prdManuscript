//-----------------------------------------------------------------------------------------//
// Never touch anything above line 300 unless you really know what you're doing
//-----------------------------------------------------------------------------------------//


//Load required packages


#include <Bounce.h>
#include <Audio.h>
#include <Wire.h>
#include <SPI.h>
#include <SD.h>
#include <SerialFlash.h>
#include <TimeLib.h>


// Initialize objects for tracking the time since power was turned on.
unsigned long timeSinceStart = 0;
unsigned long timeSincePrint = 0;

// Initialize variables to record time
int h, m, s, d, mth, yr;

// Mode flag: 0 = stopped, 1 = recording, 2 = playing
int mode = 0;  // silent

// Initialize variables to store file names
char datedir[10];
char fileName[30];

// === Audio System Setup ===
// Generated by the Teensy Audio System Design Tool (https://www.pjrc.com/teensy/gui/)
// You should not have to modify this for any reason.
AudioInputI2S i2s2;
AudioAnalyzePeak peak1;
AudioRecordQueue queue1;
AudioPlaySdWav playWav1;
AudioOutputI2S i2s1;
AudioConnection patchCord1(i2s2, 0, queue1, 0);
AudioConnection patchCord2(i2s2, 0, peak1, 0);
AudioConnection patchCord3(playWav1, 0, i2s1, 0);
AudioConnection patchCord4(playWav1, 1, i2s1, 1);
AudioControlSGTL5000 sgtl5000_1;

// Identifying how the audio will be input
const int myInput = AUDIO_INPUT_MIC;

// === SD Card Configuration ===

// Audio Playback via Audio Shield SD card
#define SDCARD_CS_PIN_PLAY 10

// Audio Recording via onboard microSD (Teensy 4.1)
// Uses SD library's built-in support
#define SDCARD_CS_PIN_REC BUILTIN_SDCARD

// File object for recording
File frec;


//Function to be used for defining the internal real time clock (RTC) to keep time
time_t getTeensy3Time() {
  return Teensy3Clock.get();
}


//Function to initialize recording
void startRecording() {
  if (!(SD.begin(SDCARD_CS_PIN_REC))) {
    // stop here if no SD card, but print a message
    while (1) {
      Serial.println("Unable to access the recording card");
      delay(500);
    }
  }

  // Initialize the SD card
  Serial.println("startRecording");
  sprintf(fileName, "%04d-%02d-%02d-%02d-%02d.RAW", year(), month(), day(), hour(), minute());

  frec = SD.open(fileName, FILE_WRITE);
  if (frec) {
    queue1.begin();
    mode = 1;
  }
}


void continueRecording() {
  if (queue1.available() >= 2) {
    byte buffer[512];
    // Fetch 2 blocks from the audio library and copy
    // into a 512 byte buffer.  The Arduino SD library
    // is most efficient when full 512 byte sector size
    // writes are used.
    memcpy(buffer, queue1.readBuffer(), 256);
    queue1.freeBuffer();
    memcpy(buffer + 256, queue1.readBuffer(), 256);
    queue1.freeBuffer();
    frec.write(buffer, 512);

  }
}

void stopRecording() {
  Serial.println("stopRecording");
  queue1.end();
  if (mode == 1) {
    while (queue1.available() > 0) {
      frec.write((byte*)queue1.readBuffer(), 256);
      queue1.freeBuffer();
    }
    frec.close();
  }
  mode = 0;
}

void startPlaying(char fileToPlay[30]) {
  if (!(SD.begin(SDCARD_CS_PIN_PLAY))) {
    // stop here if no SD card, but print a message
    while (1) {
      Serial.println("Unable to access the SD card2");
      delay(500);
    }
  }
  Serial.println("startPlaying");
  playWav1.play(fileToPlay);
  mode = 2;
}

void continuePlaying() {
  if (!playWav1.isPlaying()) {
    playWav1.stop();
    mode = 0;
  }
}

void stopPlaying() {
  Serial.println("stopPlaying");
  // if (mode == 2) playRaw1.stop();
  if (mode == 2);{
    playWav1.stop();
    mode = 0;
  }
}


void digitalClockDisplay() {
  // digital clock display of the time
  h = hour();
  m = minute();
  s = second();
  d = day();
  mth = month();
  yr = year();
  Serial.print(h);
  printDigits(m);
  printDigits(s);
  Serial.print(" ");
  Serial.print(d);
  Serial.print(" ");
  Serial.print(mth);
  Serial.print(" ");
  Serial.print(yr);
  Serial.println();
}

/*  code to process time sync messages from the serial port   */
#define TIME_HEADER "T"  // Header tag for serial time sync message

unsigned long processSyncMessage() {
  unsigned long pctime = 0L;
  const unsigned long DEFAULT_TIME = 1357041600;  // Jan 1 2013

  if (Serial.find(TIME_HEADER)) {
    pctime = Serial.parseInt();
    return pctime;
    if (pctime < DEFAULT_TIME) {  // check the value is a valid time (greater than Jan 1 2013)
      pctime = 0L;                // return 0 to indicate that the time is not valid
    }
  }
  return pctime;
}

void printDigits(int digits) {
  // utility function for digital clock display: prints preceding colon and leading 0
  Serial.print(":");
  if (digits < 10)
    Serial.print('0');
  Serial.print(digits);
}






//------------------------------------------------------------------------------------------------------//
//--The section below allows the Teensy to go to sleep--//
//------------------------------------------------------------------------------------------------------//

// This code came from https://forum.pjrc.com/index.php?threads/audio-library-wakes-up-teensy-from-hibernate.45034/page-2

#if defined (__IMXRT1062__)
  #define SNVS_LPCR_LPTA_EN_MASK          (0x2U)    ///< mask to put MCU to hibernate

  // see also https://forum.pjrc.com/threads/58484-issue-to-reporogram-T4-0?highlight=hibernate
  /**
   * @brief Set the Wakeup Call object
   *
   * @param nsec number of seconds to sleep
   */


  void setWakeupCall(uint32_t nsec)
  {
    uint32_t tmp = SNVS_LPCR; // save control register

    SNVS_LPSR |= 1;

    // disable alarm
    SNVS_LPCR &= ~SNVS_LPCR_LPTA_EN_MASK;
    while (SNVS_LPCR & SNVS_LPCR_LPTA_EN_MASK);

    __disable_irq();

    //get Time:
    uint32_t lsb, msb;
    do {
      msb = SNVS_LPSRTCMR;
      lsb = SNVS_LPSRTCLR;
    } while ( (SNVS_LPSRTCLR != lsb) | (SNVS_LPSRTCMR != msb) );
    uint32_t secs = (msb << 17) | (lsb >> 15);

    //set alarm
    secs += nsec;
    SNVS_LPTAR = secs;
    while (SNVS_LPTAR != secs);

    // restore control register and set alarm
    SNVS_LPCR = tmp | SNVS_LPCR_LPTA_EN_MASK;
    while (!(SNVS_LPCR & SNVS_LPCR_LPTA_EN_MASK));

    __enable_irq();
  }

  /**
   * @brief Shut down Tessnsy
   *
   */
  void powerDown(void)
  {
    SNVS_LPCR |= (1 << 6); // turn off power
    while (1) asm("wfi");
  }

  /**
   * @brief Set the Wakeup Call and Sleep object
   *
   * @param nsec number of seconds to sleep
   */
  void setWakeupCallandSleep(uint32_t nsec)
  {
    setWakeupCall(nsec);
    powerDown();
  }

 #endif






























//----------------------------------------------------------------------------//
//In very few cases should you ever have to modify anything above this section
//
//Remember to make sure that any sounds you want to broadcast must be uploaded
//to the SD card so you can call them specifically.
//----------------------------------------------------------------------------//


void setup() {

  AudioMemory(100);  // Audio connections require memory, and the record queue uses this memory to buffer incoming audio.
  sgtl5000_1.enable(); // Enable the audio shield, select input, and enable output
  sgtl5000_1.inputSelect(myInput);

  //Use this to change the volume. Values can be between 0 and 1
  sgtl5000_1.volume(1);

  setSyncProvider(getTeensy3Time); //Set the time library to use Teensy's RTC to keep time

}


// A function that checks if the current time is during the period when the PRDs should be active
// I left your times in there, Kylie, but tweaked it so that it is active between 4 am and 7 pm for testing purposes.
bool isMorning(int h, int m) {
    // 5:00-10:00
    return (h >= 5 && h < 10);
}

bool isAfternoon(int h, int m) {
    // 13:00–15:00
    return (h >= 13 && h < 15);
}

bool isEvening(int h, int m) {
    // 17:00–19:00
    return (h >= 17 && h < 19);
}

bool isActiveHour(int h, int m) {
    return isMorning(h, m) || isAfternoon(h, m) || isEvening(h, m);
}


void loop() {


  // --- Time Initialization ---
  timeSinceStart = millis();
  if (timeSincePrint + 1000 <= timeSinceStart) {
    Serial.print("Location Cue Treatment: Time and date ");
    digitalClockDisplay();
    timeSincePrint = timeSinceStart;
  }

  // Get current time
  int h = hour();
  int m = minute();


//Choose the times you want the PRD to go to sleep and for how long you want it to sleep.  Note, the times are in seconds
//I inserted some extra chunks (then blocked them out) in case you want to put it to sleep between your morning, afternoon, and evening playback times.

  if(mode == 0 && h == 19 && m == 1){
    setWakeupCallandSleep(32400); //Puts it to sleep for 9 hours starting at 7 pm.  This should keep it asleep until 4 am.
  }

  // if(mode == 0 && h == 10 && m == 31){
  //   setWakeupCallandSleep(7200); //Puts it to sleep for 2 hours starting after 10:30 am
  // }

  // if(mode == 0 && h == 15 && m == 1){
  //   setWakeupCallandSleep(5400); //Puts it to sleep for 1.5 hours starting after 3 pm
  // }


  // Just a reminder for the modes: 0 = stopped, 1 = recording, 2 = playing
  ///0, 9, 18, 27, 36, 45, 54,
  if (isMorning(h, m)) {
    //Northern Bobwhite
    if (mode == 0 && (m == 0 || m == 9 || m == 18 || m==27 || m==36 || m==45 || m==54)) {
      startPlaying("NOBO_LocationCue_Song.wav");
    }
    if(mode==2 && (m==1 || m==10 || m==19 || m==28 || m==37 || m==46 || m==55)){
      stopPlaying();
    }
    if(mode==0 && (m==1 || m==10 || m==19 || m==28 || m==37 || m==46 || m==55)){
      startRecording();
    }
    if(mode==1 && (m==3 || m==12 || m==21 || m==30 || m==39 || m==48 || m==57)){
      stopRecording();
    }
    //Bachman's Sparrow
     if (mode == 0 && (m == 3 || m == 12 || m == 21 || m==30 || m==39 || m==48 || m==57)) {
      startPlaying("BACS_LocationCue_PrimaryComplex.wav");
    }
    if(mode==2 && (m==4 || m==13 || m==22 || m==31 || m==40 || m==49 || m==58)){
      stopPlaying();
    }
      if(mode==0 && (m==4 || m==13 || m==22 || m==31 || m==40 || m==49 || m==58)){
      startRecording();
    }
    if(mode==1 && (m==6 || m==15 || m==24 || m==33|| m==42 || m==51 || m==0)){
      stopRecording();
    }
  //Prairie Warbler
    //SongA+B
    if (mode == 0 && (m == 6 || m == 15 || m == 24 || m==33 || m==42|| m==51)) {
      startPlaying("PRAW_LocationCue_SongA+B.wav");
    }
    if(mode==2 && (m==7|| m==16 || m==25|| m==34 || m==43|| m==52)){
      stopPlaying();
    }
      if(mode==0 && (m==7|| m==16 || m==25|| m==34 || m==43|| m==52)){
      startRecording();
    }
    if(mode==1 && (m==9 || m==18 || m==27 || m==36 || m==45|| m==54)){
      stopRecording();
    }

  //Afternoon  

} else if (isAfternoon(h, m)) {
    //Northern Bobwhite
    if (mode == 0 && (m==0 || m==18 || m==36 || m==54)) {
      startPlaying("NOBO_LocationCue_Song.wav");
    }
    if(mode==2 && (m==1 || m==19 || m==37 || m==55)){
      stopPlaying();
    }
    if(mode==0 && (m==1 || m==19 || m==37 || m==55)){
      startRecording();
    }
    if(mode==1 && (m==3 || m==21 ||m==39 || m==57)){
      stopRecording();
    }
    //Bachman's Sparrow
    if (mode == 0 && (m==6 || m==24 || m==42)) {
      startPlaying("BACS_LocationCue_PrimaryComplex.wav");
    }
    if(mode==2 && (m==7 || m==25 || m==43)){
      stopPlaying();
    }
      if(mode==0 && (m==7 || m==25 || m==43)){
      startRecording();
    }
    if(mode==1 && (m==9 || m==27 || m==45)){
      stopRecording();
    }

  //Prairie Warbler
    //SongA/B
    if (mode == 0 && (m==12 || m==30 || m==48)) {
      startPlaying("PRAW_LocationCue_SongA+B.wav");
    }
    if(mode==2 && (m==13 || m==31 || m==49)){
      stopPlaying();
    }
      if(mode==0 && (m==13 || m==31 || m==49)){
      startRecording();
    }
    if(mode==1 && (m==15 || m==33 || m==51)){
      stopRecording();
    }

//Evening
} else if (isEvening(h, m)) {
     //Northern Bobwhite
    if (mode == 0 && (m==0 || m==12 || m==24 || m==36 || m==48)) {
      startPlaying("NOBO_LocationCue_Song.wav");
    }
    if(mode==2 && (m==1 || m==13 || m==25 || m==37 || m==49)){
      stopPlaying();
    }
    if(mode==0 && (m==1 || m==13 || m==25 || m==37 || m==49)){
      startRecording();
    }
    if(mode==1 && (m==3 || m==15 ||m==27 || m==39 || m==51)){
      stopRecording();
    }
    //Bachman's Sparrow
    if (mode == 0 && (m==6 || m==18 || m==30 || m==42|| m==54)) {
      startPlaying("BACS_LocationCue_PrimaryComplex.wav");
    }
    if(mode==2 && (m==7 || m==19 || m==31 || m==43|| m==55)){
      stopPlaying();
    }
      if(mode==0 && (m==7 || m==19 || m==31 || m==43|| m==55)){
      startRecording();
    }
    if(mode==1 && (m==9 || m==21 || m==33 || m==45|| m==57)){
      stopRecording();
    }



//I left this in here just in case you want to reuse any of it. It was from the previous version of the code
    // During active hours, alternate play and record
    // if (m % 2 == 0 && mode == 0) {
    //   // startPlaying("Tone1000Hz05Amplitude.wav");
    //   startPlaying("runningwater.WAV");
    // }
        // if (m % 2 == 1 && mode == 2) {
    //   stopPlaying();
    // }
    // if (m % 2 == 1 && mode == 0) {
    //   startRecording();
    // }
    // if (m % 2 == 0 && mode == 1) {
    //   stopRecording();
    // }
    



  } else {
    // Outside active hours, ensure everything is stopped
    if (mode == 2) {
      stopPlaying();
    }
    if (mode == 1) {
      stopRecording();
    }

  }


  // Maintain current activity
  if (mode == 1) {
    continueRecording();
  } else if (mode == 2) {
    continuePlaying();
  }
}


