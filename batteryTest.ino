// -----------------------------------------------------------------------------
// Program Overview
// -----------------------------------------------------------------------------
// This program controls a Teensy 4.1–based playback and recording device (PRD)
// equipped with the PJRC Audio Shield. The device performs scheduled playback
// of WAV files and records ambient audio as RAW data to the SD card. Playback
// and recording occur at fixed times each hour, using the Teensy’s real-time
// clock (RTC) for scheduling.
//
// The system uses:
//   • I2S digital audio input/output
//   • SGTL5000 audio codec (on the Audio Shield)
//   • Teensy 4.1 built‑in SD card for recording
//   • External SD card (Audio Shield) for playback
//
// Audio is buffered using the Teensy Audio Library’s queue system, which
// ensures reliable 44.1 kHz recording even with variable SD card write latency.
// -----------------------------------------------------------------------------


// -----------------------------------------------------------------------------
// Library Imports
// -----------------------------------------------------------------------------
#include <Bounce.h>          // Debouncing for physical buttons (not used here)
#include <Audio.h>           // Teensy Audio Library
#include <Wire.h>            // I2C communication (SGTL5000, RTC)
#include <SPI.h>             // SPI for SD card access
#include <SD.h>              // SD card file handling
#include <SerialFlash.h>     // Flash memory support (not used here)
#include <TimeLib.h>         // Timekeeping and RTC integration


// -----------------------------------------------------------------------------
// Global Variables
// -----------------------------------------------------------------------------
unsigned long timeSinceStart = 0;
unsigned long timeSincePrint = 0;

int h, m, s, d, mth, yr;      // Time components from RTC

char datedir[10];            // Directory name: YYYY/MM
char fileName[30];           // Recording filename: YYYY/MM/DD-HH-MM.RAW


// -----------------------------------------------------------------------------
// Audio System Configuration (auto‑generated by Teensy Audio System Design Tool)
// -----------------------------------------------------------------------------
AudioInputI2S            i2s2;           // Digital audio input from SGTL5000
AudioAnalyzePeak         peak1;          // Peak amplitude analysis (unused)
AudioRecordQueue         queue1;         // Audio buffer for recording
AudioPlaySdWav           playWav1;       // WAV playback from SD card
AudioOutputI2S           i2s1;           // Digital audio output to SGTL5000

AudioConnection patchCord1(i2s2, 0, queue1, 0);
AudioConnection patchCord2(i2s2, 0, peak1, 0);
AudioConnection patchCord3(playWav1, 0, i2s1, 0);
AudioConnection patchCord4(playWav1, 1, i2s1, 1);

AudioControlSGTL5000 sgtl5000_1;         // Audio codec control interface


// -----------------------------------------------------------------------------
// Hardware Configuration
// -----------------------------------------------------------------------------

// Select microphone input on the Audio Shield
const int myInput = AUDIO_INPUT_MIC;

// SD card pins for playback (Audio Shield)
#define SDCARD_CS_PIN_PLAY    10
#define SDCARD_MOSI_PIN_PLAY   7   // Ignored on Teensy 4.x
#define SDCARD_SCK_PIN_PLAY   14   // Ignored on Teensy 4.x

// SD card pins for recording (Teensy 4.1 built‑in SD slot)
#define SDCARD_CS_PIN_REC     BUILTIN_SDCARD
#define SDCARD_MOSI_PIN_REC   11   // Not used
#define SDCARD_SCK_PIN_REC    13   // Not used

// Mode tracking: 0 = idle, 1 = recording, 2 = playing
int mode = 0;

// File handle for active recording
File frec;


// -----------------------------------------------------------------------------
// Setup
// -----------------------------------------------------------------------------
void setup() {

  // Allocate audio memory for buffering (100 blocks ≈ 300 ms)
  AudioMemory(100);

  // Initialize audio codec
  sgtl5000_1.enable();
  sgtl5000_1.inputSelect(myInput);
  sgtl5000_1.volume(0.5);

  // Sync system time with Teensy 3.x/4.x RTC
  setSyncProvider(getTeensy3Time);
}



// -----------------------------------------------------------------------------
// Main Loop
// -----------------------------------------------------------------------------
void loop() {

  // Update time and print once per second
  timeSinceStart = millis();
  if (timeSincePrint + 1000 == timeSinceStart) {
    digitalClockDisplay();
    timeSincePrint = timeSinceStart;
  }

  // ---------------------------------------------------------------------------
  // Scheduled Playback and Recording Logic
  // ---------------------------------------------------------------------------
  // The device performs:
  //   • Playback at minute 38 and 58
  //   • Recording at minute 33 and 59
  //   • Stop playback/recording one minute later
  //
  // Active hours: 08:00–20:59
  // ---------------------------------------------------------------------------

  bool activeHour = (h >= 8 && h <= 20);

  // --- Playback start ---
  if (activeHour && (m == 38 || m == 58) && mode == 0) {
    startPlaying();
  }

  // --- Playback stop ---
  if (activeHour && (m == 39 || m == 59) && mode == 2) {
    stopPlaying();
  }

  // --- Recording start ---
  if (activeHour && (m == 33 || m == 59) && mode == 0) {
    startRecording();
  }

  // --- Recording stop ---
  if (activeHour && (m == 34 || m == 0) && mode == 1) {
    stopRecording();
  }

  // Continue active processes
  if (mode == 1) continueRecording();
  if (mode == 2) continuePlaying();

  // Optional: automatic microphone gain control
  if (myInput == AUDIO_INPUT_MIC) adjustMicLevel();
}



// -----------------------------------------------------------------------------
// Recording Functions
// -----------------------------------------------------------------------------

// Begin a new RAW audio recording
void startRecording() {

  // Initialize SD card (Teensy 4.1 internal slot)
  SPI.setMOSI(SDCARD_MOSI_PIN_REC);
  SPI.setSCK(SDCARD_SCK_PIN_REC);

  if (!SD.begin(SDCARD_CS_PIN_REC)) {
    while (1) {
      Serial.println("Unable to access the recording card");
      delay(500);
    }
  }

  Serial.println("startRecording");

  // Create directory structure: /YYYY/MM
  sprintf(datedir, "%04d/%02d", year(), month());
  SD.mkdir(datedir);

  // Create filename: /YYYY/MM/DD-HH-MM.RAW
  sprintf(fileName, "/%04d/%02d/%02d-%02d-%02d.RAW",
          year(), month(), day(), hour(), minute());

  frec = SD.open(fileName, FILE_WRITE);

  if (frec) {
    queue1.begin();   // Start audio buffering
    mode = 1;
  }
}


// Write buffered audio to SD card
void continueRecording() {

  // Write in 512‑byte blocks (optimal for SD card)
  if (queue1.available() >= 2) {

    byte buffer[512];

    memcpy(buffer,       queue1.readBuffer(), 256);
    queue1.freeBuffer();
    memcpy(buffer + 256, queue1.readBuffer(), 256);
    queue1.freeBuffer();

    frec.write(buffer, 512);
  }
}


// Stop recording and flush remaining buffers
void stopRecording() {

  Serial.println("stopRecording");
  queue1.end();

  if (mode == 1) {
    while (queue1.available() > 0) {
      frec.write((byte*)queue1.readBuffer(), 256);
      queue1.freeBuffer();
    }
    frec.close();
  }

  mode = 0;
}



// -----------------------------------------------------------------------------
// Playback Functions
// -----------------------------------------------------------------------------

void startPlaying() {

  // Initialize SD card on Audio Shield
  SPI.setMOSI(SDCARD_MOSI_PIN_PLAY);
  SPI.setSCK(SDCARD_SCK_PIN_PLAY);

  if (!SD.begin(SDCARD_CS_PIN_PLAY)) {
    while (1) {
      Serial.println("Unable to access the SD card2");
      delay(500);
    }
  }

  Serial.println("startPlaying");

  // Play WAV file stored on Audio Shield SD card
  playWav1.play("BACS_PublicInfo_F+beg.WAV");

  mode = 2;
}


// Continue playback until file ends
void continuePlaying() {

  if (!playWav1.isPlaying()) {
    playWav1.stop();
    mode = 0;
  }
}


// Stop playback manually
void stopPlaying() {

  Serial.println("stopPlaying");

  if (mode == 2) {
    playWav1.stop();
    mode = 0;
  }
}



// -----------------------------------------------------------------------------
// Utility Functions
// -----------------------------------------------------------------------------

void adjustMicLevel() {
  // Placeholder for automatic gain control
  // (peak1 can be used to read input amplitude)
}


// Print current time and audio memory usage
void digitalClockDisplay() {

  h = hour();
  m = minute();
  s = second();
  d = day();
  mth = month();
  yr = year();

  Serial.print(h);
  printDigits(m);
  printDigits(s);
  Serial.print(" ");

  Serial.print(d);
  Serial.print(" ");
  Serial.print(mth);
  Serial.print(" ");
  Serial.print(yr);

  Serial.print(" CurrentMemory ");
  Serial.print(AudioMemoryUsage());

  Serial.print(" MaxMemory ");
  Serial.print(AudioMemoryUsageMax());

  Serial.println();
}


// RTC time retrieval
time_t getTeensy3Time() {
  return Teensy3Clock.get();
}


// Print time with leading zeros
void printDigits(int digits) {
  Serial.print(":");
  if (digits < 10) Serial.print('0');
  Serial.print(digits);
}
